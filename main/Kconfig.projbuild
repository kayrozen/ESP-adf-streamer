## sdkconfig.defaults
```kconfig
# Target
CONFIG_IDF_TARGET="esp32"

# CPU frequency — 240 MHz (default is 160 MHz).
#
# Log 26 root cause: steady-state HTTP throughput was stuck at ~9.2 KB/s
# (= 108 KB/s PCM) regardless of WiFi power-save config (PS_NONE in log 24
# and PS_MIN_MODEM+li=1 in log 26 measured identically). That rules out the
# network/WiFi path as the steady-state bottleneck. The boot log showed
# "cpu freq: 160000000 Hz" and the monitor's CPU runtime-stats table failed
# to render. The pipeline runs MP3 decode + SBC encode (a2dp_stream) + BT/WiFi
# coexistence concurrently; at 160 MHz the MP3 decoder can only produce ~108
# KB/s of PCM, below the 192 KB/s real-time rate for 48kHz/stereo/16-bit, so
# the A2DP sink underruns continuously -> choppy audio. BT airtime is not the
# limit (~25 KB/s of SBC over a >1 Mbps link is trivial); CPU throughput is.
# 240 MHz gives 50% more compute (~9.2 -> ~13.8 KB/s), which combined with the
# existing PSRAM jitter buffers should clear real-time.
CONFIG_ESP_DEFAULT_CPU_FREQ_MHZ_240=y

# PSRAM — WROVER-B cache fix (mfix-esp32-psram-cache-issue equivalent)
CONFIG_SPIRAM=y
CONFIG_SPIRAM_MODE_QUAD=y
CONFIG_SPIRAM_SPEED_80M=y
CONFIG_SPIRAM_USE_MALLOC=y
CONFIG_SPIRAM_MEMTEST=n
CONFIG_SPIRAM_CACHE_WORKAROUND=y
CONFIG_SPIRAM_CACHE_LIBJMP_IN_IRAM=y
CONFIG_SPIRAM_CACHE_LIBMATH_IN_IRAM=y
CONFIG_SPIRAM_CACHE_LIBNUMPARSER_IN_IRAM=y
CONFIG_SPIRAM_CACHE_LIBIO_IN_IRAM=y
CONFIG_SPIRAM_CACHE_LIBTIME_IN_IRAM=y
CONFIG_SPIRAM_CACHE_LIBCHAR_IN_IRAM=y
CONFIG_SPIRAM_CACHE_LIBMEM_IN_IRAM=y
CONFIG_SPIRAM_CACHE_LIBSTR_IN_IRAM=y
CONFIG_SPIRAM_CACHE_LIBRAND_IN_IRAM=y
CONFIG_SPIRAM_CACHE_LIBEVENT_IN_IRAM=y
CONFIG_SPIRAM_CACHE_LIBSOCKET_IN_IRAM=y

# WiFi + LWIP buffers -> PSRAM first.  Second half of the ESP-ADF coexistence memory
# recipe (see the Bluedroid PSRAM note in the Bluetooth section): try to allocate WiFi
# and LWIP memory from PSRAM, falling back to internal DRAM only when PSRAM is full.
# This moves the LWIP pbufs / TCP segment buffers and WiFi control structures (the
# non-DMA allocations) off internal DRAM — directly relieving the internal-heap pressure
# that produced the "wifi:m f null" flood during the TLS handshake (logs 61/62/63).
# DMA-capable WiFi RX/TX buffers necessarily remain internal; this option does not touch
# them.  Depends on SPIRAM_USE_MALLOC=y (set above).  Renamed from the v4.x
# CONFIG_WIFI_LWIP_ALLOCATION_FROM_SPIRAM_FIRST; this is the v5.2 symbol.
CONFIG_SPIRAM_TRY_ALLOCATE_WIFI_LWIP=y

# Flash size 16MB
CONFIG_ESPTOOLPY_FLASHSIZE_16MB=y

# Partition table
CONFIG_PARTITION_TABLE_CUSTOM=y
CONFIG_PARTITION_TABLE_CUSTOM_FILENAME="partitions.csv"

# Bluetooth — classic BT only (no BLE needed for A2DP)
CONFIG_BT_ENABLED=y
CONFIG_BT_CLASSIC_ENABLED=y
CONFIG_BT_A2DP_ENABLE=y
CONFIG_BT_SPP_ENABLED=n
CONFIG_BT_HFP_ENABLE=n
CONFIG_BT_BLE_ENABLED=n
CONFIG_BT_STACK_NO_LOG=n
# Controller memory for Classic BT
CONFIG_BTDM_CTRL_MODE_BR_EDR_ONLY=y

# Bluedroid HOST memory -> PSRAM.  THE fix for the deterministic TLS-handshake crash
# (logs 61/62/63): a "wifi:m f null"/"wifi:mem fail" flood during the first https
# handshake, followed by vQueueDelete(NULL) or abort() — i.e. WiFi failing to allocate
# a DMA RX buffer from internal DRAM, then a downstream queue/semaphore create returning
# NULL and its cleanup path asserting.  Pure internal-DRAM exhaustion: heap-pre-pipeline
# was only 54 KB (log 63), and the concurrent BT-A2DP + WiFi-RX-burst + TLS handshake
# drove it to zero.
#
# Prior fixes nibbled KB off WiFi buffers and the http stack while the ~40 KB Bluedroid
# host allocation sat pinned in internal DRAM the whole time — which is why none of them
# worked.  ESP-ADF's own design guide (design-guide/design-considerations.rst) is explicit:
# for WiFi + Bluetooth + PSRAM coexistence you MUST move the Bluedroid host and the
# WiFi/LWIP buffers to PSRAM, or "it will not leave enough memory for an audio application."
# BT_ALLOCATION_FROM_SPIRAM_FIRST routes Bluedroid host allocations (~40 KB) to PSRAM; the
# BT *controller* (BTDM) DMA memory necessarily stays internal.  Depends on
# SPIRAM_USE_MALLOC=y (set above).  WiFi RX DMA buffers also stay internal (DMA), but
# freeing ~40 KB of Bluedroid lets those DMA allocs succeed during the handshake burst.
CONFIG_BT_ALLOCATION_FROM_SPIRAM_FIRST=y

# WiFi — PSRAM forces STATIC TX buffers, so shrink the static pool instead.
#
# The trap that bit logs 18 AND 20: we tried to switch TX to dynamic to free
# internal DRAM, but ESP-IDF v5.3.1 gates dynamic TX behind
#     config ESP_WIFI_DYNAMIC_TX_BUFFER
#         depends on !SPIRAM_USE_MALLOC
# and we run CONFIG_SPIRAM_USE_MALLOC=y. So CONFIG_ESP_WIFI_DYNAMIC_TX_BUFFER=y
# is silently dropped (unmet dependency) and the choice falls back to STATIC 16
# = 25.6KB of internal DRAM pinned at wifi init — exactly what every log kept
# showing ("Init static tx buffer num: 16"), even though CI builds clean. The
# IDF help confirms it: "If PSRAM is enabled, Static should be selected."
#
# Dynamic is therefore off the table. Free DRAM by cutting the STATIC TX pool
# from 16 to 6. We receive audio (HTTP GET); TX is only TCP ACKs (~40B), so 6
# buffers is ample. 6 × 1.6KB = 9.6KB vs 16 × 1.6KB = 25.6KB → frees ~16KB of
# internal DRAM, lifting the streaming-phase floor from ~26KB (where log 20
# crashed in lwIP after ~1s of audio) to ~42KB.
#
# Static RX kept at 8 — these hold inbound audio frames; dropping them risks
# losing data under BT/WiFi coexistence.
#
# Log 56: with NUM=6, "wifi:m f null" appeared 11× during the TLS handshake
# (the ACK burst peaks at the TCP window boundary just as mbedTLS sends the
# ClientFinished). The 6-buffer pool was sized for steady-state TCP ACKs only;
# TLS adds a short burst of larger writes. Raised to 10 (16 KB) to eliminate
# exhaustion. DRAM cost: +6.4 KB (4 extra × 1.6 KB); leaves ~12 KB DRAM free
# after element stacks, which is still safe. If min-ever heap stays above 8 KB
# in the next log, 10 is the correct value.
#
# VERIFY in the next log: "Init static tx buffer num: 10" at wifi init, and
# zero "wifi:m f null" lines during TLS handshake.
CONFIG_ESP_WIFI_STATIC_TX_BUFFER=y
CONFIG_ESP_WIFI_STATIC_TX_BUFFER_NUM=10
CONFIG_ESP_WIFI_STATIC_RX_BUFFER_NUM=8
# Dynamic RX stays at 8.  Log 61 exposed the ceiling — a flood of "wifi:m f null"
# (WiFi failing to allocate a dynamic RX buffer from internal DRAM) then NULL-queue
# asserts, heap-at-start down to 21 KB.  Log 62 (IDF 5.2.3) brought boot internal heap
# to 37 KB, giving ~29 KB of headroom after the 8 KB http stack.  We do NOT trim this
# pool: WIFI_RX_BA_WIN is 6 and IDF enforces WIFI_DYNAMIC_RX_BUFFER_NUM >= WIFI_RX_BA_WIN
# at compile time (wifi_init.c #error), so 6 is the absolute floor.
CONFIG_ESP_WIFI_DYNAMIC_RX_BUFFER_NUM=8
CONFIG_ESP_WIFI_AMPDU_TX_ENABLED=y
CONFIG_ESP_WIFI_AMPDU_RX_ENABLED=y

# lwIP — TCP receive window and send buffer.
#
# MSS = 1440 bytes. Window must be >= 2*MSS (2880) to keep lwIP's
# "ACK every 2nd segment" fast path. Below 2*MSS every ACK waits for the
# 200ms delayed-ACK timer, capping throughput near 14KB/s.
#
# History: log 21 (li=3, 307ms modem sleep) had ACKs delayed 300-1600ms, so
# PR #18 raised the window to 8*MSS=11520 to push a big burst before each
# stall. That was correct WHEN WIFI WAS THE BOTTLENECK.
#
# Log 27/28 changed the regime. With 240 MHz + the decoder on Core 1 (PR #22)
# the CPU is no longer the limit: the startup burst fills the buffers at
# 20+ KiB/s. Steady-state then SETTLES to ~12 KiB/s (79% of the 15.6 KiB/s
# real-time rate) — not because WiFi is starved, but because the A2DP TX path
# back-pressures it: the BT->speaker L2CAP channel congests
# ("BT_L2CAP: l2cab is_cong_cback_context" in bursts), the 256KB PCM ring
# fills, http_stream blocks, and WiFi idles down to match BT's drain. The
# speaker underruns -> choppy. Internal DRAM also bottoms out at 6 KB min-ever.
#
# The 8*MSS window is now actively harmful: (a) it lets the server send long
# contiguous bursts, so WiFi holds the radio for long stretches during each
# 102ms (li=1) wake and starves BT of the airtime it needs to drain SBC; and
# (b) when http_stream stalls under back-pressure, lwIP holds up to ~11.5KB of
# RX pbufs in internal DRAM, driving the heap floor down to where the BT
# controller's DMA-capable ACL TX buffers fail to allocate -> more congestion.
# (The earlier note that the window costs ~no internal DRAM was wrong: pbufs
# for received-but-undrained data ARE held in internal DRAM until the app
# reads them, and a stalled consumer pins up to a full window's worth.)
#
# Fix: drop to 4*MSS=5760. This keeps the >=2*MSS fast-ACK path (no delayed-ACK
# stall — li=1 already gives prompt 102ms ACKs and the icecast RTT is low, so
# 4*MSS sustains far more than the 15.6 KiB/s needed), while halving the
# worst-case pbuf buffering (frees internal DRAM, lifts the heap floor) and
# shortening WiFi's radio bursts so BT A2DP gets airtime more regularly.
#
# VERIFY in the next log: fewer/no "BT_L2CAP: l2cab is_cong" bursts, internal
# min-ever heap above ~12 KB, and steady-state HTTP pos rate >= 15.6 KiB/s.
#
# SND_BUF (send side) stays at 2880: we're a receiver (HTTP GET), so
# outbound data is only TCP ACKs (~40B each); a smaller send buffer is fine.
#
# Pin MSS=1440 explicitly so the window stays exactly 4*MSS. The IDF v5.3.1
# default already resolves to 1440 (confirmed by "tcp mss: 1440" in the logs),
# but defining it here keeps the 4*MSS relationship robust if the default ever
# drifts — otherwise a changed MSS would silently break the >=2*MSS fast-ACK
# alignment this window size depends on.
CONFIG_LWIP_TCP_MSS=1440
CONFIG_LWIP_TCP_WND_DEFAULT=5760
CONFIG_LWIP_TCP_SND_BUF_DEFAULT=2880

# Audio pipeline — allow element task stacks to be allocated in PSRAM.
#
# ADF routes PSRAM stacks through xTaskCreateRestrictedPinnedToCore(), which is NOT a
# stock IDF symbol — it is injected by ADF's idf_patches/idf_vX.Y_freertos.patch.  ADF
# v2.8 ships those patches only up to idf_v5.2 (there is no idf_v5.3 patch).  On the
# previous IDF v5.3.1 build the symbol was therefore absent, ADF fell back to internal
# DRAM ("allocate stack on internal memory"), and log 61 hit the internal-DRAM ceiling:
# a "wifi:m f null" flood + NULL-queue asserts, heap-at-start down to 21 KB.
#
# The CI builds on IDF v5.2 (see .github/workflows/build.yml) and applies
# idf_v5.2_freertos.patch, so xTaskCreateRestrictedPinnedToCore() exists and PSRAM
# stacks work.  We keep the feature available but all per-element cfg.stack_in_ext are
# currently false (see create_http_stream(), create_mp3_decoder(), etc. in pipeline.c).
# NOTE: moving the http stack to PSRAM (PR #42, log 62) did NOT fix the TLS-handshake
# crash and reverting it (PR #43, log 63) did NOT either — both crashed identically.
# The crash is internal-DRAM exhaustion, not a stack-location issue; the actual fix is
# the Bluedroid + WiFi/LWIP -> PSRAM moves (BT_ALLOCATION_FROM_SPIRAM_FIRST and
# SPIRAM_TRY_ALLOCATE_WIFI_LWIP above), which free ~40+ KB of internal DRAM — far more
# than relocating an 8 KB stack ever could.
CONFIG_SPIRAM_BOOT_INIT=y
CONFIG_SPIRAM_ALLOW_STACK_EXTERNAL_MEMORY=y
CONFIG_AUDIO_ELEMENT_TASK_STACK_SIZE=3584

# FreeRTOS stack overflow detection — canary pattern at stack low-water mark, checked on every
# context switch.  Minimal overhead; makes overflows fail loudly with the task name instead of
# silently corrupting adjacent heap objects (the bug that caused the vQueueDelete crash).
CONFIG_FREERTOS_CHECK_STACKOVERFLOW_CANARY=y

# HTTP stream task stack — 8 KB is sufficient for mbedTLS TLS 1.2 RSA call frames (ASN.1 parsing,
# key exchange).  With MBEDTLS_EXTERNAL_MEM_ALLOC=y the 32 KB TLS I/O buffers live in PSRAM;
# only the call-frame chain sits on the http task stack.  The previous 12 KB value was based on a
# misread of the log-55 backtrace (corrupted by the vQueueDelete heap corruption, now fixed).
# 12→8 KB frees 4 KB of internal DRAM that esp_timer_create needs for its MALLOC_CAP_INTERNAL
# allocation during the TLS handshake.  FREERTOS_CHECK_STACKOVERFLOW_CANARY will catch any genuine
# overflow loudly (task name + stack address) before it corrupts adjacent heap objects.
CONFIG_HTTP_STREAM_TASK_STACK_SIZE=8192

# Logging
CONFIG_LOG_DEFAULT_LEVEL_DEBUG=y
CONFIG_LOG_MAXIMUM_LEVEL_DEBUG=y
CONFIG_LOG_COLORS=y

# FreeRTOS runtime stats (needed for CPU monitoring in Phase C)
CONFIG_FREERTOS_USE_TRACE_FACILITY=y
CONFIG_FREERTOS_GENERATE_RUN_TIME_STATS=y
CONFIG_FREERTOS_RUN_TIME_STATS_USING_ESP_TIMER=y
# ADF v2.8 audio_hal.h uses xSemaphoreHandle (pre-FreeRTOS-v8 typedef)
CONFIG_FREERTOS_ENABLE_BACKWARD_COMPATIBILITY=y

# Watchdog — extend for debug builds
CONFIG_ESP_TASK_WDT_TIMEOUT_S=30
CONFIG_ESP_TASK_WDT_CHECK_IDLE_TASK_CPU0=n
CONFIG_ESP_TASK_WDT_CHECK_IDLE_TASK_CPU1=n

# NVS encryption off for prototype
CONFIG_NVS_ENCRYPTION=n

# MBEDTLS for HTTPS streams
CONFIG_MBEDTLS_CERTIFICATE_BUNDLE=y
CONFIG_MBEDTLS_CERTIFICATE_BUNDLE_DEFAULT_FULL=y

# TLS — skip server certificate verification (prototype only).
#
# ESP-IDF v5.3.1 added a strict check in esp_mbedtls_set_client_config():
# if none of {cacert_buf, crt_bundle_attach, use_global_ca_store,
# skip_server_cert_verify} is set, the TLS setup returns
# ESP_ERR_MBEDTLS_SSL_SETUP_FAILED ("No server verification option set").
#
# ESP-ADF v2.8's http_stream.c was released before this check existed and
# does NOT set crt_bundle_attach on its internal esp_http_client_config_t,
# so every https:// URL (AAC Icecast, HLS Radio France, BBC HLS) hit this
# error immediately after the station switch, producing:
#   E esp-tls-mbedtls: No server verification option set … [0x8017]
# and aborting the stream (observed in logs 41/42 at the first MP3→AAC
# switch 30 s into Phase D rotation).
#
# CONFIG_ESP_TLS_SKIP_SERVER_CERT_VERIFY makes skip_server_cert_verify=true
# the default, which satisfies the check without requiring cert data.
# CONFIG_ESP_TLS_INSECURE must be enabled first (it gates the skip option).
# The cert bundle symbols above are kept so they can be wired in properly
# when productising (replace skip with crt_bundle_attach in http_stream).
CONFIG_ESP_TLS_INSECURE=y
CONFIG_ESP_TLS_SKIP_SERVER_CERT_VERIFY=y

# mbedTLS allocations -> PSRAM (not internal DRAM).
#
# After the skip-verify fix above, TLS got one step further and failed in
# mbedtls_ssl_setup() with:
#   E esp-tls-mbedtls: mbedtls_ssl_setup returned -0x7F00
#   I esp-tls-mbedtls: SSL - Memory allocation failed
# -0x7F00 = MBEDTLS_ERR_SSL_ALLOC_FAILED. ssl_setup() allocates the TLS record
# I/O buffers (default 16 KB in + 16 KB out = 32 KB) from INTERNAL DRAM, where
# our streaming-phase min-ever is ~7 KB (logs 41/42) — far too little, so the
# allocation fails and the https:// stream aborts on open.
#
# CONFIG_MBEDTLS_EXTERNAL_MEM_ALLOC routes all mbedTLS allocations to PSRAM
# (~3.7 MB free) instead of internal DRAM. The 32 KB of TLS buffers are not
# DMA buffers, so PSRAM is a valid home for them. This is the IDF-recommended
# configuration for TLS on PSRAM-equipped boards with tight internal DRAM.
# (Requires CONFIG_SPIRAM_USE_MALLOC=y, already set above.)
CONFIG_MBEDTLS_EXTERNAL_MEM_ALLOC=y

# Phase D — station rotation: cycle MP3 -> AAC -> HLS mono -> HLS multi every
# 30 s without dropping the A2DP link. Exercises the decoder hot-swap
# (MP3<->AAC) and the HTTPS/TLS + HLS-playlist paths that the plaintext MP3
# baseline never touched.
#
# NOTE: this option is defined in main/Kconfig.projbuild (a COMPONENT dir).
# ESP-IDF only scans Kconfig.projbuild inside components, never the project
# root — a root-level Kconfig.projbuild is silently ignored, which is why the
# first Phase D enable (PR #28) had no effect.
CONFIG_PROTOTYPE_PHASE_D_ROTATION=y
```
